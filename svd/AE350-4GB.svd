# AE350_4GB register map
Vendor: Andes Technology; Series: AE350; File version: 1.3.0
Registers are 32-bit, read-write, reset 0x0 unless marked. A register's access mark holds for its fields unless they carry their own. Offsets are from the block's base; [hi:lo] are bit positions; {n}, {i} and the like mark numbered series.

## PLIC_IntSrc128_255Priority — Platform-Level Interrupt Controller
Base 0xE4000000
{0x0+4i} IntSrc{i}Priority reset 0x1 (i=128..255) — Interrupt Source {i} Priority
  [?] FIELD_1

## PLIC_IntSrc256_383Priority — Platform-Level Interrupt Controller
Base 0xE4000000
{0x0+4i} IntSrc{i}Priority reset 0x1 (i=256..383) — Interrupt Source {i} Priority
  [?] FIELD_1

## PLIC_IntSrc384_511Priority — Platform-Level Interrupt Controller
Base 0xE4000000
{0x0+4i} IntSrc{i}Priority reset 0x1 (i=384..511) — Interrupt Source {i} Priority
  [?] FIELD_1

## PLIC_IntSrc512_639Priority — Platform-Level Interrupt Controller
Base 0xE4000000
{0x0+4i} IntSrc{i}Priority reset 0x1 (i=512..639) — Interrupt Source {i} Priority
  [?] FIELD_1

## PLIC_IntSrc640_767Priority — Platform-Level Interrupt Controller
Base 0xE4000000
{0x0+4i} IntSrc{i}Priority reset 0x1 (i=640..767) — Interrupt Source {i} Priority
  [?] FIELD_1

## PLIC_IntSrc768_895Priority — Platform-Level Interrupt Controller
Base 0xE4000000
{0x0+4i} IntSrc{i}Priority reset 0x1 (i=768..895) — Interrupt Source {i} Priority
  [?] FIELD_1

## PLIC_IntSrc896_1023Priority — Platform-Level Interrupt Controller
Base 0xE4000000
{0x0+4i} IntSrc{i}Priority reset 0x1 (i=896..1023) — Interrupt Source {i} Priority
  [?] FIELD_1

## PLIC_IntPending — Platform-Level Interrupt Controller
Base 0xE4000000
0x1000 IntPending1_31 — Interrupt Pending 1~31
  [?] FIELD_1
0x1004 IntPending32_63 — Interrupt Pending 32~63
  [?] FIELD_1
0x1008 IntPending64_95 — Interrupt Pending 64~95
  [?] FIELD_1
0x100C IntPending96_127 — Interrupt Pending 96~127
  [?] FIELD_1
0x1010 IntPending128_159 — Interrupt Pending 128~159
  [?] FIELD_1
0x1014 IntPending160_191 — Interrupt Pending 160~191
  [?] FIELD_1
0x1018 IntPending192_223 — Interrupt Pending 192~223
  [?] FIELD_1
0x101C IntPending224_255 — Interrupt Pending 224~255
  [?] FIELD_1
0x1020 IntPending256_287 — Interrupt Pending 256~287
  [?] FIELD_1
0x1024 IntPending288_319 — Interrupt Pending 288~319
  [?] FIELD_1
0x1028 IntPending320_351 — Interrupt Pending 320~351
  [?] FIELD_1
0x102C IntPending352_383 — Interrupt Pending 352~383
  [?] FIELD_1
0x1030 IntPending384_415 — Interrupt Pending 384~415
  [?] FIELD_1
0x1034 IntPending416_447 — Interrupt Pending 416~447
  [?] FIELD_1
0x1038 IntPending448_479 — Interrupt Pending 448~479
  [?] FIELD_1
0x103C IntPending480_511 — Interrupt Pending 480~511
  [?] FIELD_1
0x1040 IntPending512_543 — Interrupt Pending 512~543
  [?] FIELD_1
0x1044 IntPending544_575 — Interrupt Pending 544~575
  [?] FIELD_1
0x1048 IntPending576_607 — Interrupt Pending 576~607
  [?] FIELD_1
0x104C IntPending608_639 — Interrupt Pending 608~639
  [?] FIELD_1
0x1050 IntPending640_671 — Interrupt Pending 640~671
  [?] FIELD_1
0x1054 IntPending672_703 — Interrupt Pending 672~703
  [?] FIELD_1
0x1058 IntPending704_735 — Interrupt Pending 704~735
  [?] FIELD_1
0x105C IntPending736_767 — Interrupt Pending 736~767
  [?] FIELD_1
0x1060 IntPending768_799 — Interrupt Pending 768~799
  [?] FIELD_1
0x1064 IntPending800_831 — Interrupt Pending 800~831
  [?] FIELD_1
0x1068 IntPending832_863 — Interrupt Pending 832~863
  [?] FIELD_1
0x106C IntPending864_895 — Interrupt Pending 864~895
  [?] FIELD_1
0x1070 IntPending896_927 — Interrupt Pending 896~927
  [?] FIELD_1
0x1074 IntPending928_959 — Interrupt Pending 928~959
  [?] FIELD_1
0x1078 IntPending960_991 — Interrupt Pending 960~991
  [?] FIELD_1
0x107C IntPending992_1023 — Interrupt Pending 992~1023
  [?] FIELD_1

## PLIC_IntTriggerType — Platform-Level Interrupt Controller
Base 0xE4000000
0x1080 IntTriggerType1_31 ro — Interrupt Trigger Type 1~31
  [?] FIELD_1 rw
0x1084 IntTriggerType32_63 ro — Interrupt Trigger Type 32~63
  [?] FIELD_1 rw
0x1088 IntTriggerType64_95 ro — Interrupt Trigger Type 64~95
  [?] FIELD_1 rw
0x108C IntTriggerType96_127 ro — Interrupt Trigger Type 96~127
  [?] FIELD_1 rw
0x1090 IntTriggerType128_159 ro — Interrupt Trigger Type 128~159
  [?] FIELD_1 rw
0x1094 IntTriggerType160_191 ro — Interrupt Trigger Type 160~191
  [?] FIELD_1 rw
0x1098 IntTriggerType192_223 ro — Interrupt Trigger Type 192~223
  [?] FIELD_1 rw
0x109C IntTriggerType224_255 ro — Interrupt Trigger Type 224~255
  [?] FIELD_1 rw
0x10A0 IntTriggerType256_287 ro — Interrupt Trigger Type 256~287
  [?] FIELD_1 rw
0x10A4 IntTriggerType288_319 ro — Interrupt Trigger Type 288~319
  [?] FIELD_1 rw
0x10A8 IntTriggerType320_351 ro — Interrupt Trigger Type 320~351
  [?] FIELD_1 rw
0x10AC IntTriggerType352_383 ro — Interrupt Trigger Type 352~383
  [?] FIELD_1 rw
0x10B0 IntTriggerType384_415 ro — Interrupt Trigger Type 384~415
  [?] FIELD_1 rw
0x10B4 IntTriggerType416_447 ro — Interrupt Trigger Type 416~447
  [?] FIELD_1 rw
0x10B8 IntTriggerType448_479 ro — Interrupt Trigger Type 448~479
  [?] FIELD_1 rw
0x10BC IntTriggerType480_511 ro — Interrupt Trigger Type 480~511
  [?] FIELD_1 rw
0x10C0 IntTriggerType512_543 ro — Interrupt Trigger Type 512~543
  [?] FIELD_1 rw
0x10C4 IntTriggerType544_575 ro — Interrupt Trigger Type 544~575
  [?] FIELD_1 rw
0x10C8 IntTriggerType576_607 ro — Interrupt Trigger Type 576~607
  [?] FIELD_1 rw
0x10CC IntTriggerType608_639 ro — Interrupt Trigger Type 608~639
  [?] FIELD_1 rw
0x10D0 IntTriggerType640_671 ro — Interrupt Trigger Type 640~671
  [?] FIELD_1 rw
0x10D4 IntTriggerType672_703 ro — Interrupt Trigger Type 672~703
  [?] FIELD_1 rw
0x10D8 IntTriggerType704_735 ro — Interrupt Trigger Type 704~735
  [?] FIELD_1 rw
0x10DC IntTriggerType736_767 ro — Interrupt Trigger Type 736~767
  [?] FIELD_1 rw
0x10E0 IntTriggerType768_799 ro — Interrupt Trigger Type 768~799
  [?] FIELD_1 rw
0x10E4 IntTriggerType800_831 ro — Interrupt Trigger Type 800~831
  [?] FIELD_1 rw
0x10E8 IntTriggerType832_863 ro — Interrupt Trigger Type 832~863
  [?] FIELD_1 rw
0x10EC IntTriggerType864_895 ro — Interrupt Trigger Type 864~895
  [?] FIELD_1 rw
0x10F0 IntTriggerType896_927 ro — Interrupt Trigger Type 896~927
  [?] FIELD_1 rw
0x10F4 IntTriggerType928_959 ro — Interrupt Trigger Type 928~959
  [?] FIELD_1 rw
0x10F8 IntTriggerType960_991 ro — Interrupt Trigger Type 960~991
  [?] FIELD_1 rw
0x10FC IntTriggerType992_1023 ro — Interrupt Trigger Type 992~1023
  [?] FIELD_1 rw
